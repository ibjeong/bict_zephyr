## app/boards/arm/awaresite_nrf52840/Kconfig.board
```kconfig
# awaresite board configuration

config BOARD_AWARESITE_NRF52840
	bool "awaresite"
	depends on SOC_NRF52840_QIAA
```

## app/boards/arm/awaresite_nrf52840/Kconfig.defconfig
```kconfig
# awaresite board configuration

if BOARD_AWARESITE_NRF52840

config BOARD
	default "awaresite_nrf52840"

config BT_CTLR
	default BT

config DISK_DRIVER_SDMMC
	default y

config I2C
	default y

config PWM
	default y

endif # BOARD_AWARESITE_NRF52840
```
